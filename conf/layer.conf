## conf/layer.conf
```bitbake
BBPATH .= ":${LAYERDIR}"

BBFILES += "${LAYERDIR}/recipes-*/*/*.bb \
${LAYERDIR}/recipes-*/*/*.bbappend"

BBFILE_COLLECTIONS += "vtk"
BBFILE_PATTERN_vtk := "^${LAYERDIR}/"
BBFILE_PRIORITY_vtk = "6"

LICENSE_PATH += "${LAYERDIR}/licenses"

LAYERDEPENDS_vtk = "core openembedded-layer meta-python qt4-layer"
```
